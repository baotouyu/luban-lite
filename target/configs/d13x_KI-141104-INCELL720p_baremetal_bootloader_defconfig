## target/configs/d13x_KI-141104-INCELL720p_baremetal_bootloader_defconfig
```kconfig
CONFIG_PRJ_DEFCONFIG_FILENAME="d13x_KI-141104-INCELL720p_baremetal_bootloader_defconfig"
CONFIG_PRJ_CHIP="d13x"
CONFIG_PRJ_BOARD="KI-141104-INCELL720p"
CONFIG_PRJ_KERNEL="baremetal"
CONFIG_PRJ_APP="bootloader"
CONFIG_PRJ_CUSTOM_LDS="application/baremetal/bootloader/ldscript/d13x_bootloader_gcc.ld"
CONFIG_AIC_USING_UART0=y
CONFIG_AIC_UART0_DMA_ENABLE_FLAG=y
CONFIG_AIC_DEV_UART0_RX_MODE_INT=y
CONFIG_AIC_DEV_UART0_RX_BUFSZ=2048
CONFIG_AIC_DEV_UART0_TX_BUFSZ=2048
CONFIG_AIC_USING_QSPI0=y
CONFIG_AIC_QSPI0_DEVICE_SPINOR=y
CONFIG_AIC_USING_SDMC1=y
CONFIG_AIC_SDMC1_BUSWIDTH1=y
CONFIG_AIC_USING_DE=y
CONFIG_AIC_DISP_MIPI_DSI=y
CONFIG_AICFB_RGB565=y
# CONFIG_AIC_DISP_BOOTUP_LOGO is not set
CONFIG_AIC_PANEL_DSI_ILI9883C=y
CONFIG_AIC_PWM_BACKLIGHT=y
CONFIG_AIC_PWM_BACKLIGHT_CHANNEL=1
CONFIG_AIC_PWM_BACKLIGHT_PERIOD_NS=50000
CONFIG_AIC_PWM_BRIGHTNESS_LEVEL=80
# CONFIG_AIC_USING_GE is not set
# CONFIG_AIC_USING_VE is not set
CONFIG_AIC_USING_DMA=y
CONFIG_AIC_USING_WRI=y
CONFIG_AIC_USING_RTC=y
CONFIG_AIC_USING_WDT=y
CONFIG_AIC_SRAM_TOTAL_SIZE=0x80000
CONFIG_AIC_PSRAM_SW_SIZE=0x300000
CONFIG_AIC_INTERRUPTSTACK_SIZE=8192
CONFIG_AIC_USING_SID=y
CONFIG_AIC_SYSCFG_LDO1X_ENABLE=y
CONFIG_AIC_NORMALSTACK_SIZE=8192
CONFIG_AIC_BOOTLOADER_TEXT_SIZE=0x7FF00
CONFIG_AIC_BOOTLOADER_CONSOLE_UART=0
# CONFIG_AIC_BOOTLOADER_SPINAND_SUPPORT is not set
CONFIG_AIC_BOOTLOADER_PSRAM_EN=y
CONFIG_AIC_XSPI_PSRAM_CS0_PINS=0
CONFIG_AIC_XSPI_PSRAM_CS1_PINS=0
CONFIG_AIC_MTD_BARE_DRV=y
CONFIG_AICUPG_UART_ENABLE=y
CONFIG_AICUPG_USB_ENABLE=y
CONFIG_AICUPG_SDCARD_ENABLE=y
CONFIG_AICUPG_SDCARD_CONTROLLER_ID=1
CONFIG_AICUPG_UDISK_ENABLE=y
CONFIG_AICUPG_MMC_ARTINCHIP=y
CONFIG_AICUPG_NOR_ARTINCHIP=y
CONFIG_AICUPG_LOG_BUFFER_SUPPORT=y
CONFIG_AIC_BOOTLOADER_CMD_NOR_BOOT=y
CONFIG_AIC_BOOTLOADER_CMD_SPI_NOR=y
CONFIG_AIC_BOOTLOADER_CMD_MTD=y
CONFIG_AIC_BOOTLOADER_CMD_PART=y
CONFIG_AIC_BOOTLOADER_CMD_PROGRESS_BAR=y
CONFIG_AIC_BOOTLOADER_CMD_FB_CONSOLE=y
# CONFIG_AIC_BOOTLOADER_CMD_MEM is not set
CONFIG_LPKG_CHERRYUSB_DEVICE_CLASS_AIC_SINGLE=y
# CONFIG_LPKG_MPP is not set
CONFIG_AIC_ENV_INTERFACE=y
CONFIG_LPKG_USING_SFUD=y
CONFIG_RT_DFS_ELM_READONLY=y
# CONFIG_DFS_USING_POSIX is not set
# CONFIG_LPKG_DFS_ELM_MINIMIZE_0 is not set
CONFIG_LPKG_DFS_ELM_MINIMIZE_2=y
```
